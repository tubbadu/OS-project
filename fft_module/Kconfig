## fft_module/Kconfig
```kconfig
config FFT_MODULE
    tristate "FFT Hardware Accelerator Module"
    depends on ARM64
    default n
    help
      This is a driver for the FFT hardware accelerator.
```

## src/buildroot-arm/package/fft_module/Config.in
```kconfig
config BR2_PACKAGE_FFT_MODULE
    bool "fft_module kernel module"
    depends on BR2_LINUX_KERNEL
    help
      A custom kernel module for FFT processing.
```
